## boards/shields/kyria_rev3_dongle/Kconfig.defconfig
```kconfig
if SHIELD_KYRIA_REV3_DONGLE

config ZMK_KEYBOARD_NAME
    default "Kyria Rev3 Dongle"

config ZMK_SPLIT_ROLE_CENTRAL
    default y

endif
```

## config/west.yml
```yaml
manifest:
  remotes:
    - name: zmkfirmware
      url-base: https://github.com/zmkfirmware
    # Additional modules containing boards/shields/custom code can be listed here as well
    # See https://docs.zephyrproject.org/3.2.0/develop/west/manifest.html#projects
    - name: englmaxi
      url-base: https://github.com/englmaxi
  projects:
    - name: zmk
      remote: zmkfirmware
      revision: main
      import: app/west.yml
    - name: zmk-dongle-display
      remote: englmaxi
      revision: main # use 'v0.3' instead of 'main' if you use have p
  self:
    path: config
```
